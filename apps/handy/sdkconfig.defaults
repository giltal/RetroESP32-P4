## apps/handy/sdkconfig.defaults
```kconfig
# Shared sdkconfig defaults for all emulator apps
# Target ESP32-P4
CONFIG_IDF_TARGET="esp32p4"

# PSRAM
CONFIG_SPIRAM=y
CONFIG_SPIRAM_MODE_HEX=y
CONFIG_SPIRAM_SPEED_200M=y
CONFIG_SPIRAM_TRY_ALLOCATE_WIFI_LWIP=y
CONFIG_SPIRAM_USE_CAPS_ALLOC=y
CONFIG_SPIRAM_ALLOW_BSS_SEG_EXTERNAL_MEMORY=y

# MIPI DSI
CONFIG_SOC_MIPI_DSI_SUPPORTED=y

# Flash size
CONFIG_ESPTOOLPY_FLASHSIZE_16MB=y

# Custom partition table (same OTA layout as launcher)
CONFIG_PARTITION_TABLE_CUSTOM=y
CONFIG_PARTITION_TABLE_CUSTOM_FILENAME="../../partitions_ota.csv"
CONFIG_PARTITION_TABLE_OFFSET=0x8000

# FreeRTOS
CONFIG_FREERTOS_HZ=1000

# Main task stack size (hardware init needs deep stack)
CONFIG_ESP_MAIN_TASK_STACK_SIZE=32768

# Log level
CONFIG_LOG_DEFAULT_LEVEL_INFO=y

# USB Host
CONFIG_USB_HOST_HUBS_SUPPORTED=y
CONFIG_USB_HOST_HW_BUFFER_BIAS_IN=y

# FAT filesystem — long filenames (required for ROM file paths)
CONFIG_FATFS_LFN_HEAP=y
CONFIG_FATFS_MAX_LFN=255

# Optimizations
CONFIG_COMPILER_OPTIMIZATION_SIZE=y
CONFIG_BOOTLOADER_COMPILER_OPTIMIZATION_SIZE=y
CONFIG_COMPILER_OPTIMIZATION_ASSERTIONS_DISABLE=y
CONFIG_RINGBUF_PLACE_FUNCTIONS_INTO_FLASH=y
CONFIG_FREERTOS_PLACE_FUNCTIONS_INTO_FLASH=y
CONFIG_HAL_ASSERTION_DISABLE=y
CONFIG_COMPILER_SAVE_RESTORE_LIBCALLS=y
CONFIG_ESP_ERR_TO_NAME_LOOKUP=n
```

## components/odroid/Kconfig.projbuild
```kconfig
menu "RetroESP32 Platform"

    config HDMI_OUTPUT
        bool "Use HDMI output (LT8912) instead of LCD (ST7701)"
        default n
        help
            When enabled, the display pipeline outputs to an HDMI monitor
            via the LT8912 MIPI-to-HDMI bridge at 640x480 RGB888.
            When disabled (default), the display outputs to the ST7701
            480x800 MIPI DSI LCD panel.

    config LT8912_I2C_SDA
        int "LT8912 I2C SDA GPIO"
        default 7
        depends on HDMI_OUTPUT

    config LT8912_I2C_SCL
        int "LT8912 I2C SCL GPIO"
        default 8
        depends on HDMI_OUTPUT

    config LT8912_RESET_GPIO
        int "LT8912 Reset GPIO"
        default 23
        depends on HDMI_OUTPUT

endmenu
```

## launcher/sdkconfig.defaults
```kconfig
# Target ESP32-P4
CONFIG_IDF_TARGET="esp32p4"

# PSRAM
CONFIG_SPIRAM=y
CONFIG_SPIRAM_MODE_HEX=y
CONFIG_SPIRAM_SPEED_200M=y
CONFIG_SPIRAM_TRY_ALLOCATE_WIFI_LWIP=y
CONFIG_SPIRAM_USE_CAPS_ALLOC=y

# BSS in external memory (sprites, UI buffers)
CONFIG_SPIRAM_ALLOW_BSS_SEG_EXTERNAL_MEMORY=y

# MIPI DSI
CONFIG_SOC_MIPI_DSI_SUPPORTED=y

# Flash size
CONFIG_ESPTOOLPY_FLASHSIZE_16MB=y

# Custom partition table (factory + OTA slots)
CONFIG_PARTITION_TABLE_CUSTOM=y
CONFIG_PARTITION_TABLE_CUSTOM_FILENAME="../partitions_ota.csv"
CONFIG_PARTITION_TABLE_OFFSET=0x8000

# FreeRTOS
CONFIG_FREERTOS_HZ=1000

# Main task stack size (hardware init needs deep stack)
CONFIG_ESP_MAIN_TASK_STACK_SIZE=32768

# Console: UART0 only. Disable USB Serial JTAG secondary console
# to prevent 50ms-per-char stalls when the USB host isn't reading.
CONFIG_ESP_CONSOLE_SECONDARY_NONE=y

# Log level
CONFIG_LOG_DEFAULT_LEVEL_INFO=y

# USB Host
CONFIG_USB_HOST_HUBS_SUPPORTED=y
CONFIG_USB_HOST_HW_BUFFER_BIAS_IN=y

# Optimizations (keep launcher small)
CONFIG_COMPILER_OPTIMIZATION_SIZE=y
CONFIG_BOOTLOADER_COMPILER_OPTIMIZATION_SIZE=y
CONFIG_COMPILER_OPTIMIZATION_ASSERTIONS_DISABLE=y

# FAT filesystem — long filenames (required for ROM browsing)
CONFIG_FATFS_LFN_HEAP=y
CONFIG_FATFS_MAX_LFN=255

# Place RINGBUF + FreeRTOS functions in flash to save IRAM
CONFIG_RINGBUF_PLACE_FUNCTIONS_INTO_FLASH=y
CONFIG_FREERTOS_PLACE_FUNCTIONS_INTO_FLASH=y
CONFIG_HAL_ASSERTION_DISABLE=y
CONFIG_COMPILER_SAVE_RESTORE_LIBCALLS=y
CONFIG_ESP_ERR_TO_NAME_LOOKUP=n
```

## sdkconfig.defaults
```kconfig
# Target ESP32-P4
CONFIG_IDF_TARGET="esp32p4"

# PSRAM
CONFIG_SPIRAM=y
CONFIG_SPIRAM_MODE_HEX=y
CONFIG_SPIRAM_SPEED_200M=y

# Allow allocating from SPIRAM with heap_caps_malloc
CONFIG_SPIRAM_TRY_ALLOCATE_WIFI_LWIP=y
CONFIG_SPIRAM_USE_CAPS_ALLOC=y

# MIPI DSI
CONFIG_SOC_MIPI_DSI_SUPPORTED=y

# Flash size
CONFIG_ESPTOOLPY_FLASHSIZE_16MB=y

# Partition table
CONFIG_PARTITION_TABLE_SINGLE_APP_LARGE=y

# FreeRTOS
CONFIG_FREERTOS_HZ=1000

# Log level
CONFIG_LOG_DEFAULT_LEVEL_INFO=y

# USB Host
CONFIG_USB_HOST_HUBS_SUPPORTED=y
CONFIG_USB_HOST_HW_BUFFER_BIAS_IN=y
```
